/* oled.c - SH1106 driver (I2C, page-addressed) with a 5x7 font */
#include "oled.h"
#include "bsp.h"

#define SH1106_COL_OFFSET 2          /* 132-col RAM, 128 visible */

static uint8_t fb[OLED_W * OLED_H / 8];   /* 8 pages x 128 cols */

/* ---- 5x7 font, ASCII 0x20..0x7E, 5 column-bytes per glyph (LSB=top) ---- */
static const uint8_t font5x7[][5] = {
    {0x00,0x00,0x00,0x00,0x00}, /* sp */ {0x00,0x00,0x5F,0x00,0x00}, /* ! */
    {0x00,0x07,0x00,0x07,0x00}, /* " */  {0x14,0x7F,0x14,0x7F,0x14}, /* # */
    {0x24,0x2A,0x7F,0x2A,0x12}, /* $ */  {0x23,0x13,0x08,0x64,0x62}, /* % */
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    {0x08,0x04,0x08,0x10,0x08}, /* ~ */
};

static void cmd(uint8_t c)
{
    uint8_t buf[2] = {0x00, c};       /* 0x00 = command stream */
    HAL_I2C_Master_Transmit(&hi2c2, ADDR_SH1106, buf, 2, 50);
}

void oled_init(void)
{
    const uint8_t seq[] = {
        0xAE,             /* display off */
        0xD5,0x80,        /* clock divide */
        0xA8,0x3F,        /* multiplex = 64 */
        0xD3,0x00,        /* display offset 0 */
        0x40,             /* start line 0 */
        0xAD,0x8B,        /* DC-DC on (SH1106; unknown-cmd nop on SSD1306) */
        0x8D,0x14,        /* charge pump on (SSD1306; nop on SH1106) */
        0xA0,             /* segment remap off  \ together: panel mounted */
        0xC0,             /* COM scan inc       / rotated 180 in enclosure */
        0xDA,0x12,        /* COM pins */
        0x81,0x80,        /* contrast */
        0xD9,0x22,        /* pre-charge */
        0xDB,0x35,        /* VCOM deselect */
        0xA4,             /* resume from RAM */
        0xA6,             /* normal (not inverted) */
        0xAF              /* display on */
    };
    HAL_Delay(100);
    for (unsigned i = 0; i < sizeof(seq); i++) cmd(seq[i]);
    oled_clear();
    oled_update();
}

void oled_contrast(uint8_t v) { cmd(0x81); cmd(v); }

void oled_clear(void) { for (unsigned i = 0; i < sizeof(fb); i++) fb[i] = 0; }

void oled_set_pixel(int x, int y, bool on)
{
    if (x < 0 || x >= OLED_W || y < 0 || y >= OLED_H) return;
    uint8_t *p = &fb[(y / 8) * OLED_W + x];
    if (on) *p |=  (1 << (y & 7));
    else    *p &= ~(1 << (y & 7));
}

void oled_char(int x, int y, char c, bool inv)
{
    if (c < 0x20 || c > 0x7E) c = '?';
    const uint8_t *g = font5x7[c - 0x20];
    for (int col = 0; col < 6; col++) {
        uint8_t bits = (col < 5) ? g[col] : 0x00;
        if (inv) bits = ~bits;
        for (int row = 0; row < 8; row++)
            oled_set_pixel(x + col, y + row, (bits >> row) & 1);
    }
}

void oled_text(int x, int y, const char *s, bool inv)
{
    while (*s) { oled_char(x, y, *s++, inv); x += 6; }
}

void oled_text_big(int x, int y, const char *s)   /* 2x nearest-neighbour */
{
    while (*s) {
        char c = *s++;
        if (c < 0x20 || c > 0x7E) c = '?';
        const uint8_t *g = font5x7[c - 0x20];
        for (int col = 0; col < 6; col++) {
            uint8_t bits = (col < 5) ? g[col] : 0x00;
            for (int row = 0; row < 8; row++) {
                bool on = (bits >> row) & 1;
                oled_set_pixel(x + col*2,   y + row*2,   on);
                oled_set_pixel(x + col*2+1, y + row*2,   on);
                oled_set_pixel(x + col*2,   y + row*2+1, on);
                oled_set_pixel(x + col*2+1, y + row*2+1, on);
            }
        }
        x += 12;
    }
}

void oled_fill_row(int page, bool on)
{
    if (page < 0 || page > 7) return;
    for (int x = 0; x < OLED_W; x++) fb[page * OLED_W + x] = on ? 0xFF : 0x00;
}

void oled_update(void)
{
    for (int page = 0; page < 8; page++) {
        cmd(0xB0 | page);                                   /* page address */
        cmd(0x00 | (SH1106_COL_OFFSET & 0x0F));             /* low column   */
        cmd(0x10 | (SH1106_COL_OFFSET >> 4));               /* high column  */
        uint8_t line[1 + OLED_W];
        line[0] = 0x40;                                     /* data stream  */
        for (int x = 0; x < OLED_W; x++) line[1 + x] = fb[page * OLED_W + x];
        HAL_I2C_Master_Transmit(&hi2c2, ADDR_SH1106, line, sizeof(line), 100);
    }
}
